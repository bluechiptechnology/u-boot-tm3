## configs/bct_tm3_defconfig
```kconfig
CONFIG_ARM=y
CONFIG_ARISCMOD=y
CONFIG_ARCH_SUNXI=y
CONFIG_DEFAULT_DEVICE_TREE="sun50i-h6-bct-tm3"
CONFIG_SPL=y
CONFIG_MACH_SUN50I_H6=y
CONFIG_SUNXI_DRAM_H6_DDR3_1333=y
CONFIG_DRAM_CLK=648
CONFIG_MMC0_CD_PIN="PG11"
CONFIG_MMC_SUNXI_SLOT_EXTRA=2
CONFIG_SPL_SPI_SUNXI=y

CONFIG_SYS_I2C_MVTWSI=y
CONFIG_SPL_I2C=y
CONFIG_DM_I2C=y
CONFIG_CMD_I2C=y

CONFIG_POWER=y
CONFIG_POWER_I2C=y
CONFIG_PMIC_CHILDREN=y
CONFIG_DM_PMIC=y
CONFIG_SPL_DM_PMIC=y
CONFIG_PMIC_AXP=y
CONFIG_SPL_PMIC_AXP=y
CONFIG_CMD_PMIC=y
CONFIG_CMD_REGULATOR=y
CONFIG_AXP_PMIC_BUS=y

CONFIG_DM_REGULATOR=y
CONFIG_CMD_REGULATOR=y
CONFIG_REGULATOR_AXP=y
CONFIG_SPL_REGULATOR_AXP=y
CONFIG_REGMAP=y
CONFIG_SPL_REGMAP=y

CONFIG_DM=y
CONFIG_DM_DEMO=y
CONFIG_DM_DEMO_SIMPLE=y
CONFIG_DM_DEMO_SHAPE=y
CONFIG_CMD_DEMO=y
```

## drivers/arisc/Kconfig
```kconfig
menu "ARISC enabler"

config ARISCMOD
	bool "Enable starting of ARISC"
	help
	  Enables starting ARISC chip on H6 SoC

endmenu
```
